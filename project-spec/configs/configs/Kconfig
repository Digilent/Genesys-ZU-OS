## project-spec/configs/configs/Kconfig
```kconfig
mainmenu "PetaLinux System Configuration"
config SUBSYSTEM_TYPE_LINUX
        bool
        default y
        select SYSTEM_ZYNQMP

config SYSTEM_ZYNQMP
        bool "ZYNQMP Configuration"
        help
          ZYNQMP Configuration for petalinux project.
          All these config options will be in /work/projects/os/zu/5ev/oob/next/project-spec/configs/config

config SUBSYSTEM_VARIANT_ZYNQMPEV
        bool
        default y
        help

config SUBSYSTEM_DISTRO_PETALINUX
        bool
        default y
        help

source /work/projects/os/zu/5ev/oob/next/project-spec/configs/configs/Kconfig.main
```

## project-spec/configs/rootfsconfigs/Kconfig.user
```kconfig
menu "user packages " 
config btop  
	 bool "btop"
	 help
	
config gpio-demo  
	 bool "gpio-demo"
	 help
	
config htop  
	 bool "htop"
	 help
	
config peekpoke  
	 bool "peekpoke"
	 help
	
endmenu
```
